
.EQU		SERVO_TESTER_1 = 7
.EQU		SERVO_TESTER_2 = 5
.EQU		ANG_TESTER_1= 1325
.EQU		ANG_TESTER_2=900

.EQU		CANT_ANGS=4


.DSEG

.ORG	0X500 ;VER DIRECCION
ANG_YAW_0:		.BYTE	(CANT_ANGS<<1)
.ORG	0X508
ANG_YAW_15:		.BYTE	(CANT_ANGS<<1)
.ORG	0X516
ANG_YAW_30:		.BYTE	(CANT_ANGS<<1)
.ORG	0X524
ANG_YAW_45:		.BYTE	(CANT_ANGS<<1)
.ORG	0X532
ANG_YAW_60:		.BYTE	(CANT_ANGS<<1)
.ORG	0X540
ANG_YAW_75:		.BYTE	(CANT_ANGS<<1)
.ORG	0X548
ANG_YAW_90:		.BYTE	(CANT_ANGS<<1)
.ORG	0X556
ANG_YAW_105:	.BYTE	(CANT_ANGS<<1)
.ORG	0X564
ANG_YAW_120:	.BYTE	(CANT_ANGS<<1)
.ORG	0X572
ANG_YAW_135:	.BYTE	(CANT_ANGS<<1)
.ORG	0X580
ANG_YAW_150:	.BYTE	(CANT_ANGS<<1)
.ORG	0X588
ANG_YAW_165:	.BYTE	(CANT_ANGS<<1)
.ORG	0X596
ANG_YAW_180:	.BYTE	(CANT_ANGS<<1)	;ANGULOS DE SERVO SUPERIOR DE CADA PATA

.ORG	0X604
ANG_ROLL_0:	.BYTE	(CANT_ANGS<<1)
.ORG	0X612
ANG_ROLL_30:	.BYTE	(CANT_ANGS<<1)
.ORG	0X620
ANG_ROLL_45:	.BYTE	(CANT_ANGS<<1)
.ORG	0X628
ANG_ROLL_60:	.BYTE	(CANT_ANGS<<1)
.ORG	0X636
ANG_ROLL_90:	.BYTE	(CANT_ANGS<<1)	;ANGULOS DE SERVO INFERIOR DE CADA PATA
.ORG	0X644
ANG_ROLL_120:	.BYTE	(CANT_ANGS<<1)
.ORG	0X652
ANG_ROLL_150:	.BYTE	(CANT_ANGS<<1)
.ORG	0X660
ANG_ROLL_180:	.BYTE	(CANT_ANGS<<1)


.CSEG

INIC_ANGULOS:
	RCALL INIC_ARR_ANG_YAW_0
	RCALL INIC_ARR_ANG_YAW_15
	RCALL INIC_ARR_ANG_YAW_30
	RCALL INIC_ARR_ANG_YAW_45
	RCALL INIC_ARR_ANG_YAW_60
	RCALL INIC_ARR_ANG_YAW_75
	RCALL INIC_ARR_ANG_YAW_90
	RCALL INIC_ARR_ANG_YAW_105
	RCALL INIC_ARR_ANG_YAW_120
	RCALL INIC_ARR_ANG_YAW_135
	RCALL INIC_ARR_ANG_YAW_150
	RCALL INIC_ARR_ANG_YAW_165
	RCALL INIC_ARR_ANG_YAW_180

	RCALL INIC_ARR_ANG_ROLL_0
	RCALL INIC_ARR_ANG_ROLL_30
	RCALL INIC_ARR_ANG_ROLL_45
	RCALL INIC_ARR_ANG_ROLL_60
	RCALL INIC_ARR_ANG_ROLL_90
	RCALL INIC_ARR_ANG_ROLL_120
	RCALL INIC_ARR_ANG_ROLL_150
	RCALL INIC_ARR_ANG_ROLL_180

	RET


;SE DEBE HACER APUNTAR A X AL ARREGLO DEL ANGULO QUE SE BUSCA
FIND_ANG_LEG:		
		MOV COUNTER,LEG_H
		LSR COUNTER
		INC	COUNTER

	LOOP_FIND_ANG_LEG:
		LD	ANG_L,X+
		LD	ANG_H,X+
		DEC COUNTER
		BREQ	SEGUIR
		RJMP LOOP_FIND_ANG_LEG

	SEGUIR:	RET



INIC_ARR_ANG_YAW_0:
	LDI ZL,LOW(ROM_ANG_YAW_0<<1)
	LDI ZH,HIGH(ROM_ANG_YAW_0<<1)
	LDI XL,LOW(ANG_YAW_0)
	LDI XH,HIGH(ANG_YAW_0)
	LDI COUNTER,(CANT_ANGS<<1)

	RCALL LOOP_ANG
	RET

INIC_ARR_ANG_YAW_15:
	LDI ZL,LOW(ROM_ANG_YAW_15<<1)
	LDI ZH,HIGH(ROM_ANG_YAW_15<<1)
	LDI XL,LOW(ANG_YAW_15)
	LDI XH,HIGH(ANG_YAW_15)
	LDI COUNTER,(CANT_ANGS<<1)

	RCALL LOOP_ANG
	RET

INIC_ARR_ANG_YAW_30:
	LDI ZL,LOW(ROM_ANG_YAW_30<<1)
	LDI ZH,HIGH(ROM_ANG_YAW_30<<1)
	LDI XL,LOW(ANG_YAW_30)
	LDI XH,HIGH(ANG_YAW_30)
	LDI COUNTER,(CANT_ANGS<<1)

	RCALL LOOP_ANG
	RET

INIC_ARR_ANG_YAW_45:
	LDI ZL,LOW(ROM_ANG_YAW_45<<1)
	LDI ZH,HIGH(ROM_ANG_YAW_45<<1)
	LDI XL,LOW(ANG_YAW_45)
	LDI XH,HIGH(ANG_YAW_45)
	LDI COUNTER,(CANT_ANGS<<1)

	RCALL LOOP_ANG
	RET

INIC_ARR_ANG_YAW_60:
	LDI ZL,LOW(ROM_ANG_YAW_60<<1)
	LDI ZH,HIGH(ROM_ANG_YAW_60<<1)
	LDI XL,LOW(ANG_YAW_60)
	LDI XH,HIGH(ANG_YAW_60)
	LDI COUNTER,(CANT_ANGS<<1)

	RCALL LOOP_ANG
	RET

INIC_ARR_ANG_YAW_75:
	LDI ZL,LOW(ROM_ANG_YAW_75<<1)
	LDI ZH,HIGH(ROM_ANG_YAW_75<<1)
	LDI XL,LOW(ANG_YAW_75)
	LDI XH,HIGH(ANG_YAW_75)
	LDI COUNTER,(CANT_ANGS<<1)

	RCALL LOOP_ANG
	RET

INIC_ARR_ANG_YAW_90:
	LDI ZL,LOW(ROM_ANG_YAW_90<<1)
	LDI ZH,HIGH(ROM_ANG_YAW_90<<1)
	LDI XL,LOW(ANG_YAW_90)
	LDI XH,HIGH(ANG_YAW_90)
	LDI COUNTER,(CANT_ANGS<<1)

	RCALL LOOP_ANG
	RET

INIC_ARR_ANG_YAW_105:
	LDI ZL,LOW(ROM_ANG_YAW_105<<1)
	LDI ZH,HIGH(ROM_ANG_YAW_105<<1)
	LDI XL,LOW(ANG_YAW_105)
	LDI XH,HIGH(ANG_YAW_105)
	LDI COUNTER,(CANT_ANGS<<1)

	RCALL LOOP_ANG
	RET

INIC_ARR_ANG_YAW_120:
	LDI ZL,LOW(ROM_ANG_YAW_120<<1)
	LDI ZH,HIGH(ROM_ANG_YAW_120<<1)
	LDI XL,LOW(ANG_YAW_120)
	LDI XH,HIGH(ANG_YAW_120)
	LDI COUNTER,(CANT_ANGS<<1)

	RCALL LOOP_ANG
	RET

INIC_ARR_ANG_YAW_135:
	LDI ZL,LOW(ROM_ANG_YAW_135<<1)
	LDI ZH,HIGH(ROM_ANG_YAW_135<<1)
	LDI XL,LOW(ANG_YAW_135)
	LDI XH,HIGH(ANG_YAW_135)
	LDI COUNTER,(CANT_ANGS<<1)

	RCALL LOOP_ANG
	RET

INIC_ARR_ANG_YAW_150:
	LDI ZL,LOW(ROM_ANG_YAW_150<<1)
	LDI ZH,HIGH(ROM_ANG_YAW_150<<1)
	LDI XL,LOW(ANG_YAW_150)
	LDI XH,HIGH(ANG_YAW_150)
	LDI COUNTER,(CANT_ANGS<<1)

	RCALL LOOP_ANG
	RET

INIC_ARR_ANG_YAW_165:
	LDI ZL,LOW(ROM_ANG_YAW_165<<1)
	LDI ZH,HIGH(ROM_ANG_YAW_165<<1)
	LDI XL,LOW(ANG_YAW_165)
	LDI XH,HIGH(ANG_YAW_165)
	LDI COUNTER,(CANT_ANGS<<1)

	RCALL LOOP_ANG
	RET

INIC_ARR_ANG_YAW_180:
	LDI ZL,LOW(ROM_ANG_YAW_180<<1)
	LDI ZH,HIGH(ROM_ANG_YAW_180<<1)
	LDI XL,LOW(ANG_YAW_180)
	LDI XH,HIGH(ANG_YAW_180)
	LDI COUNTER,(CANT_ANGS<<1)

	RCALL LOOP_ANG
	RET

INIC_ARR_ANG_ROLL_0:
	LDI ZL,LOW(ROM_ANG_ROLL_0<<1)
	LDI ZH,HIGH(ROM_ANG_ROLL_0<<1)
	LDI XL,LOW(ANG_ROLL_0)
	LDI XH,HIGH(ANG_ROLL_0)
	LDI COUNTER,(CANT_ANGS<<1)

	RCALL LOOP_ANG
	RET

INIC_ARR_ANG_ROLL_30:
	LDI ZL,LOW(ROM_ANG_ROLL_30<<1)
	LDI ZH,HIGH(ROM_ANG_ROLL_30<<1)
	LDI XL,LOW(ANG_ROLL_30)
	LDI XH,HIGH(ANG_ROLL_30)
	LDI COUNTER,(CANT_ANGS<<1)

	RCALL LOOP_ANG
	RET

INIC_ARR_ANG_ROLL_45:
	LDI ZL,LOW(ROM_ANG_ROLL_45<<1)
	LDI ZH,HIGH(ROM_ANG_ROLL_45<<1)
	LDI XL,LOW(ANG_ROLL_45)
	LDI XH,HIGH(ANG_ROLL_45)
	LDI COUNTER,(CANT_ANGS<<1)

	RCALL LOOP_ANG
	RET

INIC_ARR_ANG_ROLL_60:
	LDI ZL,LOW(ROM_ANG_ROLL_60<<1)
	LDI ZH,HIGH(ROM_ANG_ROLL_60<<1)
	LDI XL,LOW(ANG_ROLL_60)
	LDI XH,HIGH(ANG_ROLL_60)
	LDI COUNTER,(CANT_ANGS<<1)

	RCALL LOOP_ANG
	RET


INIC_ARR_ANG_ROLL_90:
	LDI ZL,LOW(ROM_ANG_ROLL_90<<1)
	LDI ZH,HIGH(ROM_ANG_ROLL_90<<1)
	LDI XL,LOW(ANG_ROLL_90)
	LDI XH,HIGH(ANG_ROLL_90)
	LDI COUNTER,(CANT_ANGS<<1)

	RCALL LOOP_ANG
	RET


INIC_ARR_ANG_ROLL_120:
	LDI ZL,LOW(ROM_ANG_ROLL_120<<1)
	LDI ZH,HIGH(ROM_ANG_ROLL_120<<1)
	LDI XL,LOW(ANG_ROLL_120)
	LDI XH,HIGH(ANG_ROLL_120)
	LDI COUNTER,(CANT_ANGS<<1)

	RCALL LOOP_ANG
	RET

INIC_ARR_ANG_ROLL_150:
	LDI ZL,LOW(ROM_ANG_ROLL_150<<1)
	LDI ZH,HIGH(ROM_ANG_ROLL_150<<1)
	LDI XL,LOW(ANG_ROLL_150)
	LDI XH,HIGH(ANG_ROLL_150)
	LDI COUNTER,(CANT_ANGS<<1)

	RCALL LOOP_ANG
	RET

INIC_ARR_ANG_ROLL_180:
	LDI ZL,LOW(ROM_ANG_ROLL_180<<1)
	LDI ZH,HIGH(ROM_ANG_ROLL_180<<1)
	LDI XL,LOW(ANG_ROLL_180)
	LDI XH,HIGH(ANG_ROLL_180)
	LDI COUNTER,(CANT_ANGS<<1)

	RCALL LOOP_ANG
	RET

LOOP_ANG:
	LPM TEMP,Z+
	ST X+,TEMP
	DEC COUNTER

	BRNE LOOP_ANG

	RET


SERVO_TEST_ANG:
	LDI 	R23,SERVO_TESTER_1
	LDI 	R24,LOW(ANG_TESTER_1)
	LDI 	R25,HIGH(ANG_TESTER_1)
	RCALL 	PCA9685_MOVE


	LDI 	R23,SERVO_TESTER_2
	LDI 	R24,LOW(ANG_TESTER_2)
	LDI 	R25,HIGH(ANG_TESTER_2)

	RCALL 	PCA9685_MOVE
	RCALL 	MOVEMENT_DELAY	

	RET


SERVO_TEST_ANG_TOTAL: ;Prueba el servo en 3 pocisiones
	LDI 	R23,SERVO_TESTER
	LDI 	R24,LOW(1800)
	LDI 	R25,HIGH(1800)
	RCALL 	PCA9685_MOVE
	RCALL 	MOVEMENT_DELAY	

	LDI 	R23,SERVO_TESTER
	LDI 	R24,LOW(1750)
	LDI 	R25,HIGH(1750)
	RCALL 	PCA9685_MOVE
	RCALL 	MOVEMENT_DELAY	

	LDI 	R23,SERVO_TESTER
	LDI 	R24,LOW(1575)
	LDI 	R25,HIGH(1575)
	RCALL 	PCA9685_MOVE
	RCALL 	MOVEMENT_DELAY	

	LDI 	R23,SERVO_TESTER
	LDI 	R24,LOW(1400)
	LDI 	R25,HIGH(1400)
	RCALL 	PCA9685_MOVE
	RCALL 	MOVEMENT_DELAY	

	LDI 	R23,SERVO_TESTER
	LDI 	R24,LOW(1250)
	LDI 	R25,HIGH(1250)
	RCALL 	PCA9685_MOVE
	RCALL 	MOVEMENT_DELAY	

	LDI 	R23,SERVO_TESTER
	LDI 	R24,LOW(1142)
	LDI 	R25,HIGH(1142)
	RCALL 	PCA9685_MOVE
	RCALL 	MOVEMENT_DELAY	

	LDI 	R23,SERVO_TESTER
	LDI 	R24,LOW(1034)
	LDI 	R25,HIGH(1034)
	RCALL 	PCA9685_MOVE
	RCALL 	MOVEMENT_DELAY	

	LDI 	R23,SERVO_TESTER
	LDI 	R24,LOW(925)
	LDI 	R25,HIGH(925)
	RCALL 	PCA9685_MOVE
	RCALL 	MOVEMENT_DELAY	

	LDI 	R23,SERVO_TESTER
	LDI 	R24,LOW(816)
	LDI 	R25,HIGH(816)
	RCALL 	PCA9685_MOVE
	RCALL 	MOVEMENT_DELAY	

	LDI 	R23,SERVO_TESTER
	LDI 	R24,LOW(708)
	LDI 	R25,HIGH(708)
	RCALL 	PCA9685_MOVE
	RCALL 	MOVEMENT_DELAY	

	LDI 	R23,SERVO_TESTER
	LDI 	R24,LOW(600)
	LDI 	R25,HIGH(600)
	RCALL 	PCA9685_MOVE
	RCALL 	MOVEMENT_DELAY	

	RET


;ARREGLOS DE ANGULOS(EN GRADOS): ANG_X: .DB PATA_1,PATA_2,PATA_3;PATA_4
;PATA:				1		2		3		4	
.ORG	0X500
ROM_ANG_YAW_0: .DW	1750,	800,	1800,	385
ROM_ANG_YAW_15:.DW	1750,	800,	1700,	450
ROM_ANG_YAW_30:.DW	1750,	800,	1600,	575
ROM_ANG_YAW_45:.DW	1750,	800,	1550,	700
ROM_ANG_YAW_60:.DW	1575,	925,	1300,	825
ROM_ANG_YAW_75:.DW	1400,	1100,	1200,	925
ROM_ANG_YAW_90:.DW	1300,	1200,	1100,	1050
ROM_ANG_YAW_105:.DW	1140,	1360,	1000,	1200
ROM_ANG_YAW_120:.DW	1030,	1490,	850,	1325
ROM_ANG_YAW_135:.DW 925,	1600,	750,	1450
ROM_ANG_YAW_150:.DW 816,	1750,	750,	1450
ROM_ANG_YAW_165:.DW	708,	1870,	750,	1450
ROM_ANG_YAW_180:.DW	600,	2000,	750,	1450		;ANGULOS DE SERVO SUPERIOR DE CADA PATA

ROM_ANG_ROLL_0:.DW	500,	500,	700,	500
ROM_ANG_ROLL_30:.DW	750,	750,	900,	800
ROM_ANG_ROLL_45:.DW	850,	850,	1000,	900
ROM_ANG_ROLL_60:.DW	950,	950,	1100,	1000
ROM_ANG_ROLL_90:.DW	1200,	1200,	1500,	1400	
ROM_ANG_ROLL_120:.DW 1450,	1450,	1500,	1400	
ROM_ANG_ROLL_150:.DW 1700,	1700,	1500,	1400	
ROM_ANG_ROLL_180:.DW 2000,	2000,	1500,	1400	;ANGULOS DE SERVO INFERIOR DE CADA PATA


