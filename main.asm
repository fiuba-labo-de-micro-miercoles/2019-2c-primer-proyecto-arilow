.INCLUDE 	"M328PDEF.INC"



.CSEG


.ORG 	0x00
	RJMP	MAIN
.ORG 	0x02
	RJMP 	EXT_INT0
.ORG 	0x1E
	RJMP	TIM1_OVF
;INTERRUPCIONES







.ORG 	INT_VECTORS_SIZE
MAIN:
INIC_SP:
	ldi r16,low(RAMEND)
	out spl,r16
	ldi r16,high(RAMEND)
	out sph,r16
	

	SBI DDRB,5


	RCALL	MOVEMENT_SETUP	;SERVOS EN POSICIсN INICIAL

	RCALL	INIC_ANGULOS	;INICIALIZA VALORES DE ANGULOS DE LOS SERVOS	


;	RCALL 	HCSR04_SETUP
;	CLR 	R21
;	CLR		R22
	
	
;	LDI 	R26,LOW(1000)
;	LDI 	R27,HIGH(1000)
;	RCALL 	MOVEMENT_LEG_1
;	SBI PORTB,5
;	LDI 	R26,LOW(1400)
;	LDI 	R27,HIGH(1400)
;	RCALL 	MOVEMENT_LEG_2
;	CBI PORTB,5
;	LDI 	R26,LOW(1400)
;	LDI 	R27,HIGH(1400)
;	RCALL 	MOVEMENT_LEG_3
;	SBI PORTB,5
;	LDI 	R26,LOW(800)
;	LDI 	R27,HIGH(800)
;	RCALL 	MOVEMENT_LEG_4
;	CBI PORTB,5


;	RCALL	SERVO_TEST

;HERE:RJMP HERE

MAIN_LOOP:
;	LDI		LEG_L,LOW(LEG_1)
;	LDI		LEG_H,HIGH(LEG_1)
;	LDI		XL,LOW(ANG_YAW_135)
;	LDI		XH,HIGH(ANG_YAW_135)
;	RCALL 	MOVEMENT_LEG
	RCALL 	MOVE_FORWARD


	RJMP 	MAIN_LOOP

TURN_ON:
	SBI PORTB,5
	RET


TURN_OFF:
	CBI PORTB,5
	RET



;error
ERRLOOP:
	RJMP	ERRLOOP

DELAY_1_S:
	PUSH	R25
	LDI		R25,100
LOOP_DELAY_1_S:
	RCALL	DELAY_10_MS
	DEC	R25
	brne LOOP_DELAY_1_S
	
	POP		R25
	RET

DELAY_10_MS:	;DELAY DE 10 MILISEGUNDOS PARA UN CLOCK DE 1MZ
	push r22
	push r24
	ldi r22, 40 ;
LOOP_DELAY_1:
	ldi R24, 85
LOOP_DELAY_2:
	DEC	R24
	brne LOOP_DELAY_2
	dec r22
	brne LOOP_DELAY_1

	pop r24
	pop r22
	ret


.INCLUDE	"DEFINES.INC"
.INCLUDE	"ANGULOS.INC"
.INCLUDE 	"MOVEMENT.INC"
.INCLUDE 	"HCSR04.INC"
