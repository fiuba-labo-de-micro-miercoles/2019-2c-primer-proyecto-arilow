.EQU 		SERVO_MAX = 2600
.EQU 		SERVO_MID = 1000
.EQU 		SERVO_MIN = 500

.EQU		LEG_1 = 0X0102
.EQU		LEG_2 = 0X0304
.EQU		LEG_3 = 0X0506
.EQU		LEG_4 = 0X0708

.EQU		SERVO_TESTER = 1

.INCLUDE 	"PCA9685.INC"






MOVEMENT_SETUP:


	RCALL 	PCA9685_SETUP
	LDI 	R23,HIGH(LEG_1)
	LDI 	R24,LOW(1000)
	LDI 	R25,HIGH(1000)
	RCALL 	PCA9685_MOVE
	;RCALL 	MOVEMENT_DELAY

	LDI 	R23,LOW(LEG_1)
	LDI 	R24,LOW(750)
	LDI 	R25,HIGH(750)
	RCALL 	PCA9685_MOVE
	;RCALL 	MOVEMENT_DELAY

	LDI 	R23,HIGH(LEG_2)
	LDI 	R24,LOW(1500)
	LDI 	R25,HIGH(1500)
	RCALL 	PCA9685_MOVE
	;RCALL 	MOVEMENT_DELAY
	
	LDI 	R23,LOW(LEG_2)
	LDI 	R24,LOW(750)
	LDI 	R25,HIGH(750)
	RCALL 	PCA9685_MOVE
	;RCALL 	MOVEMENT_DELAY
	
	LDI 	R23,HIGH(LEG_3)
	LDI 	R24,LOW(1400)
	LDI 	R25,HIGH(1400)
	RCALL 	PCA9685_MOVE
	;RCALL 	MOVEMENT_DELAY
	
	LDI 	R23,LOW(LEG_3)
	LDI 	R24,LOW(900)
	LDI 	R25,HIGH(900)
	RCALL 	PCA9685_MOVE
	;RCALL 	MOVEMENT_DELAY
	
	LDI 	R23,HIGH(LEG_4)
	LDI 	R24,LOW(800)
	LDI 	R25,HIGH(800)
	RCALL 	PCA9685_MOVE
	;RCALL 	MOVEMENT_DELAY
	
	LDI 	R23,LOW(LEG_4)
	LDI 	R24,LOW(800)
	LDI 	R25,HIGH(800)
	RCALL 	PCA9685_MOVE

	
	RET


MOVE_FORWARD:
	RCALL	MOVE_LEFT_FORWARD
	RCALL	INCLINE_LEFT_FORWARD
	RCALL	MOVE_RIGHT_FORWARD
	RCALL	INCLINE_RIGHT_FORWARD
	RCALL	MOVEMENT_DELAY

	RET

MOVE_LEFT_FORWARD:
	LDI		LEG_L,LOW(LEG_1)
	LDI		LEG_H,HIGH(LEG_1)
	LDI		XL,LOW(ANG_YAW_150)
	LDI		XH,HIGH(ANG_YAW_150)
	RCALL 	MOVEMENT_LEG

	LDI		LEG_L,LOW(LEG_3)
	LDI		LEG_H,HIGH(LEG_3)
	LDI		XL,LOW(ANG_YAW_90)
	LDI		XH,HIGH(ANG_YAW_90)
	RCALL 	MOVEMENT_LEG

	RET

INCLINE_LEFT_FORWARD:
	PUSH	XL
	PUSH	XH

	LDI		LEG_L,LOW(LEG_2)
	LDI		LEG_H,HIGH(LEG_2)

	LDI		XL,LOW(ANG_YAW_90)
	LDI		XH,HIGH(ANG_YAW_90)

	RCALL	FIND_ANG_LEG
	MOV 	R23,LEG_H
	RCALL 	PCA9685_MOVE
	RCALL 	DELAY_1_S		;PATA 2 A 90°


	LDI		LEG_L,LOW(LEG_1)
	LDI		LEG_H,HIGH(LEG_2)

	LDI		XL,LOW(ANG_YAW_135)
	LDI		XH,HIGH(ANG_YAW_135)

	RCALL	FIND_ANG_LEG
	MOV 	R23,LEG_H
	RCALL 	PCA9685_MOVE
	RCALL 	DELAY_1_S		;PATA 1 A 135°

	LDI		LEG_L,LOW(LEG_4)
	LDI		LEG_H,HIGH(LEG_4)

	LDI		XL,LOW(ANG_YAW_30)
	LDI		XH,HIGH(ANG_YAW_30)

	RCALL	FIND_ANG_LEG
	MOV 	R23,LEG_H
	RCALL 	PCA9685_MOVE
	RCALL 	DELAY_1_S		;PATA 4 A 30°

	LDI		LEG_L,LOW(LEG_3)
	LDI		LEG_H,HIGH(LEG_3)

	LDI		XL,LOW(ANG_YAW_45)
	LDI		XH,HIGH(ANG_YAW_45)

	RCALL	FIND_ANG_LEG
	MOV 	R23,LEG_H
	RCALL 	PCA9685_MOVE
	RCALL 	DELAY_1_S		;PATA 3 A 45°

	POP	XL
	POP	XH

	RET

MOVE_RIGHT_FORWARD:
	LDI		LEG_L,LOW(LEG_2)
	LDI		LEG_H,HIGH(LEG_2)
	LDI		XL,LOW(ANG_YAW_150)
	LDI		XH,HIGH(ANG_YAW_150)
	RCALL 	MOVEMENT_LEG

	LDI		LEG_L,LOW(LEG_4)
	LDI		LEG_H,HIGH(LEG_4)
	LDI		XL,LOW(ANG_YAW_90)
	LDI		XH,HIGH(ANG_YAW_90)
	RCALL 	MOVEMENT_LEG

	RET


INCLINE_RIGHT_FORWARD:
	PUSH	XL
	PUSH	XH

	LDI		LEG_L,LOW(LEG_1)
	LDI		LEG_H,HIGH(LEG_1)

	LDI		XL,LOW(ANG_YAW_90)
	LDI		XH,HIGH(ANG_YAW_90)

	RCALL	FIND_ANG_LEG
	MOV 	R23,LEG_H
	RCALL 	PCA9685_MOVE
	RCALL 	DELAY_1_S		;PATA 1 A 90°


	LDI		LEG_L,LOW(LEG_2)
	LDI		LEG_H,HIGH(LEG_2)

	LDI		XL,LOW(ANG_YAW_135)
	LDI		XH,HIGH(ANG_YAW_135)

	RCALL	FIND_ANG_LEG
	MOV 	R23,LEG_H
	RCALL 	PCA9685_MOVE
	RCALL 	DELAY_1_S		;PATA 2 A 135°

	LDI		LEG_L,LOW(LEG_3)
	LDI		LEG_H,HIGH(LEG_3)

	LDI		XL,LOW(ANG_YAW_30)
	LDI		XH,HIGH(ANG_YAW_30)

	RCALL	FIND_ANG_LEG
	MOV 	R23,LEG_H
	RCALL 	PCA9685_MOVE
	RCALL 	DELAY_1_S		;PATA 3 A 30°

	LDI		LEG_L,LOW(LEG_4)
	LDI		LEG_H,HIGH(LEG_4)

	LDI		XL,LOW(ANG_YAW_45)
	LDI		XH,HIGH(ANG_YAW_45)

	RCALL	FIND_ANG_LEG
	MOV 	R23,LEG_H
	RCALL 	PCA9685_MOVE
	RCALL 	DELAY_1_S		;PATA 4 A 45°

	RET

MOV_BACK_LEG_1:
	LDI R26,LOW(1400)
	LDI R27,HIGH(1400)
	RCALL MOVEMENT_LEG

	RET


;HAY QUE INICIALIZAR X CON EL VALOR DEL ANGULO	EN EL QUE SE QUIERE PONER LA PATA
MOVEMENT_LEG:
	PUSH	XL
	PUSH	XH

	LDI		XL,LOW(ANG_ROLL_60)
	LDI		XH,HIGH(ANG_ROLL_60)

	RCALL	FIND_ANG_LEG
	MOV 	R23,LEG_L
;	LDI 	R24,ANG_L
;	LDI 	R25,ANG_H
	RCALL 	PCA9685_MOVE
	RCALL 	MOVEMENT_DELAY
	
	POP		XH
	POP		XL

	RCALL	FIND_ANG_LEG
	MOV 	R23,LEG_H
;	MOV 	R24,ANG_L
;	MOV 	R25,ANG_H
	RCALL 	PCA9685_MOVE
	RCALL 	MOVEMENT_DELAY

	LDI		XL,LOW(ANG_ROLL_30)
	LDI		XH,HIGH(ANG_ROLL_30)

	RCALL	FIND_ANG_LEG

	MOV 	R23,LEG_L
;	LDI 	R24,LOW(500)
;	LDI 	R25,HIGH(500)
	RCALL 	PCA9685_MOVE
	RCALL 	MOVEMENT_DELAY

	RET



MOVEMENT_TEST:	
	LDI 	R23,0
	LDI 	R24,LOW(500)
	LDI 	R25,HIGH(500)
	RCALL 	PCA9685_MOVE
	RCALL 	MOVEMENT_DELAY
	
	LDI 	R23,0
	LDI 	R24,LOW(1000)
	LDI 	R25,HIGH(1000)
	RCALL 	PCA9685_MOVE
	RCALL 	MOVEMENT_DELAY	


	LDI 	R23,1
	LDI 	R24,LOW(1700)
	LDI 	R25,HIGH(1700)
	RCALL 	PCA9685_MOVE
	RCALL 	MOVEMENT_DELAY

	LDI 	R23,0
	LDI 	R24,LOW(500)
	LDI 	R25,HIGH(500)
	RCALL 	PCA9685_MOVE
	RCALL 	MOVEMENT_DELAY
	
	LDI 	R23,0
	LDI 	R24,LOW(1000)
	LDI 	R25,HIGH(1000)
	RCALL 	PCA9685_MOVE
	RCALL 	MOVEMENT_DELAY

	LDI 	R23,1
	LDI 	R24,LOW(1000)
	LDI 	R25,HIGH(1000)
	RCALL 	PCA9685_MOVE
	RCALL 	MOVEMENT_DELAY

	RET


MOVEMENT_DELAY:
	push r22
	push r24
	push r25
	ldi r22, 100 ;
MOVEMENT_OUTER_LOOP:
	ldi r24, low(90)
	ldi r25, high(90)
MOVEMENT_DELAY_LOOP:
	adiw r25:r24,1
	brne MOVEMENT_DELAY_LOOP
	nop
	dec r22
	brne MOVEMENT_OUTER_LOOP
	pop r25
	pop r24
	pop r22
	ret



	SERVO_TEST: ;Prueba el servo en 3 pocisiones
	LDI 	R23,SERVO_TESTER
	LDI 	R24,LOW(SERVO_MAX)
	LDI 	R25,HIGH(SERVO_MAX)
	RCALL 	PCA9685_MOVE
	RCALL 	MOVEMENT_DELAY	

	LDI 	R23,SERVO_TESTER
	LDI 	R24,LOW(SERVO_MID)
	LDI 	R25,HIGH(SERVO_MID)
	RCALL 	PCA9685_MOVE

	RCALL 	MOVEMENT_DELAY	

	LDI 	R23,SERVO_TESTER
	LDI 	R24,LOW(SERVO_MIN)
	LDI 	R25,HIGH(SERVO_MIN)
	RCALL 	PCA9685_MOVE

	RCALL 	MOVEMENT_DELAY	

	RET
	
